## conf/distro/include/rdk-turris.inc
```bitbake
DISTRO_FEATURES_append = " rdk-oss-ssa"
DISTRO_FEATURES_remove_dunfell = "telemetry2_0"

# RDKBDEV-73 : Dynamic DNS : Standardization based on broadband-forum.
DISTRO_FEATURES_append = " ddns_broadband"

# RDKBDEV-83 : Device Gateway Association using Managed Device
DISTRO_FEATURES_append = " device_gateway_association"

# RDKBDEV-50: Adding DSLite Functionality and related TR-181 DataModel Parameters
DISTRO_FEATURES_append = " dslite"

# REFPLTV-1137: DLNA support for xupnp
DISTRO_FEATURES_append = " dlna"

DISTRO_FEATURES_append = " webconfig_bin"

DISTRO_FEATURES_append = " meshwifi"
DISTRO_FEATURES_append = " ipv6"
DISTRO_FEATURES_append = " rdkb_cellular_manager"
DISTRO_FEATURES_append = " rdkb_wan_manager"
DISTRO_FEATURES_append = " rdkb_inter_device_manager"

# RDKB-40900: RDKB support extender/nonrouter profile
DISTRO_FEATURES_append_extender = " rdkb_extender"

# RDKB-44824: CoreNetLib move bb file location
DISTRO_FEATURES_append = " core-net-lib"

#Kernel upgrade
DISTRO_FEATURES_append = " kernel5.x"

# Fix RDK Cellular Manager build errors
DISTRO_FEATURES_append = " RbusBuildFlagEnable"
```

## conf/layer.conf
```bitbake
# We have a conf and classes directory, add to BBPATH
BBPATH .= ":${LAYERDIR}"

# We have a recipes-* directories, add to BBFILES
BBFILES += "${LAYERDIR}/recipes-*/*/*.bb \
	${LAYERDIR}/recipes-*/*/*.bbappend"

BBFILE_COLLECTIONS += "turris"
BBFILE_PATTERN_turris = "^${LAYERDIR}/"
BBFILE_PRIORITY_turris = "8"

LAYERSERIES_COMPAT_turris = "dunfell"

require conf/distro/include/rdk-turris.inc
require conf/include/rdk-external-src-platform.inc

#masking files for dunfell build
require conf/include/turris-bbmasks.inc
```

## conf/machine/include/armada38x-base-turris.inc
```bitbake
# Provides the Marvell Armada 38x common settings
require conf/machine/include/tune-cortexa9.inc
DEFAULTTUNE_armada38x ??= "armv7ahf-neon"
MACHINEOVERRIDES =. "armada38x:"
# Packages essential for booting
MACHINE_ESSENTIAL_EXTRA_RDEPENDS += " \
    kernel-image \
    kernel-devicetree \
    u-boot-script \
"
IMAGE_FSTYPES += "tar.bz2 ext2 wic.bz2"
SERIAL_CONSOLE = "115200 ttyS0"
#PREFERRED_PROVIDER_virtual/kernel ?= "linux-marvell"
KERNEL_IMAGETYPE = "zImage"
PREFERRED_PROVIDER_u-boot ??= "u-boot-turris"
PREFERRED_PROVIDER_u-boot-fw-utils ??= "u-boot-fw-utils-turris"
PREFERRED_RPROVIDER_u-boot-fw-utils ??= "u-boot-fw-utils-turris"
PREFERRED_PROVIDER_u-boot-script ??= "u-boot-script-turris"
PREFERRED_PROVIDER_virtual/bootloader ??= "u-boot-turris"
UBOOT_SUFFIX = "bin"
WKS_FILES_append_armada38x = " armada38x.wks"
WKS_FILE_DEPENDS ?= ""
WKS_FILE ?= "turris.wks"
do_image_wic[depends] += "u-boot-turris:do_populate_sysroot"
MACHINE_FEATURES = "ext2 ipsec nfs pci smbfs usbgadget usbhost vfat"
```

## conf/machine/turris-bci.conf
```bitbake
#@TYPE: Machine
#@NAME: turris-bci
#@NEEDED_BSPLAYERS: meta-turris
#@DESCRIPTION: Machine configuration for running a RDK broadband on turris omnia
#@RDK_FLAVOR: rdkb

MACHINEOVERRIDES .= ":bci"

require turris.conf

DISTRO_FEATURES_append = " bci"
DISTRO_FEATURES_append = " bci_webui_jst"

DISTRO_FEATURES_remove = " rdkb_extender"

# REFPLTB-1457: WiFi HAL 3.0 support for TurrisOmnia
DISTRO_FEATURES_append = " halVersion3"
```

## conf/machine/turris-extender.conf
```bitbake
#@TYPE: Machine
#@NAME: turris-omnia
#@NEEDED_BSPLAYERS: meta-turris
#@DESCRIPTION: Machine configuration for running a RDK Extender on turris omnia
#@RDK_FLAVOR: rdkb

require conf/machine/include/armada38x-base.inc

KERNEL_DEVICETREE = "armada-385-turris-omnia.dtb"

UBOOT_MARVELL_MACHINE = "armada_38x"

MACHINE_EXTRA_RRECOMMENDS += "kernel-modules"

IMAGE_BOOT_FILES = "zImage zImage-armada-385-turris-omnia.dtb;armada-385-turris-omnia.dtb boot.scr"

MACHINE_IMAGE_NAME = "rdkb-generic-extender-image"
TCLIBC = "musl"

MACHINEOVERRIDES .= ":extender:turris"

PREFERRED_VERSION_linux-marvell = "4.14.22"
PREFERRED_VERSION_linux-libc-headers = "4.14.22"
PREFERRED_VERSION_xfsprogs = "4.8.0"
PREFERRED_VERSION_php = "7.1.%"
PREFERRED_VERSION_php-native = "7.1.%"

KERNEL_IMAGETYPE = "zImage"

RDKCENTRAL_GITHUB_BRANCH ?= "master"
RDKCENTRAL_GITHUB_ROOT ?= "git://github.com/rdkcentral"
RDKCENTRAL_GITHUB_PROTOCOL ?= "https"

DISTRO_FEATURES_append = " extender"
DISTRO_FEATURES_remove = "telemetry2_0"
```

## conf/machine/turris.conf
```bitbake
#@TYPE: Machine
#@NAME: turris-omnia
#@NEEDED_BSPLAYERS: meta-turris
#@DESCRIPTION: Machine configuration for running a RDK broadband on turris omnia
#@RDK_FLAVOR: rdkb

require conf/machine/include/armada38x-base-turris.inc

KERNEL_DEVICETREE = "armada-385-turris-omnia.dtb"

MACHINE_EXTRA_RRECOMMENDS += "kernel-modules"

IMAGE_BOOT_FILES = "zImage zImage-armada-385-turris-omnia.dtb;armada-385-turris-omnia.dtb boot.scr"
IMAGE_BOOT_FILES_dunfell = "zImage armada-385-turris-omnia.dtb boot.scr"

MACHINE_IMAGE_NAME = "rdkb-generic-broadband-image"
TCLIBC = "glibc"

UBOOT_MACHINE = "turris_omnia_defconfig"
MACHINEOVERRIDES .= ":broadband:turris"

PREFERRED_PROVIDER_u-boot ??= "u-boot-turris"
PREFERRED_PROVIDER_u-boot-fw-utils ??= "u-boot-fw-utils-turris"
PREFERRED_RPROVIDER_u-boot-fw-utils ??= "u-boot-fw-utils-turris"
PREFERRED_PROVIDER_u-boot-script ??= "u-boot-script-turris"
PREFERRED_PROVIDER_virtual/bootloader ??= "u-boot-turris"

PREFERRED_PROVIDER_virtual/kernel ?= "linux-marvell"
PREFERRED_VERSION_linux-marvell = "4.14.22"
PREFERRED_VERSION_linux-libc-headers = "4.14.22"
PREFERRED_VERSION_xfsprogs = "4.8.0"
PREFERRED_VERSION_php_dunfell = "7.1.%"
PREFERRED_VERSION_php-native_dunfell = "7.1.%"

PREFERRED_PROVIDER_hal-wifi = "hal-wifi-cfg80211"

KERNEL_IMAGETYPE = "zImage"

#for sysupgrade image creation
IMAGE_FSTYPES += " wic"
do_image_wic[depends] += " dosfstools-native:do_populate_sysroot mtools-native:do_populate_sysroot"

#for sdk support
INHERIT_append = " uninative"
BB_SETSCENE_ENFORCE_WHITELIST_append = " %:* *:do_fetch *"
```

## conf/machine/turris_5.10.conf
```bitbake
#@TYPE: Machine
#@NAME: turris-omnia
#@NEEDED_BSPLAYERS: meta-turris
#@DESCRIPTION: Machine configuration for running a RDK broadband on turris omnia
#@RDK_FLAVOR: rdkb

require conf/machine/include/armada38x-base-turris.inc

KERNEL_DEVICETREE = "armada-385-turris-omnia.dtb"

MACHINE_EXTRA_RRECOMMENDS += "kernel-modules"

IMAGE_BOOT_FILES = "zImage zImage-armada-385-turris-omnia.dtb;armada-385-turris-omnia.dtb boot.scr"
IMAGE_BOOT_FILES_dunfell = "zImage armada-385-turris-omnia.dtb boot.scr"

TCLIBC = "glibc"

UBOOT_MACHINE = "turris_omnia_defconfig"
MACHINEOVERRIDES .= ":broadband:turris:turris5.10"

PREFERRED_PROVIDER_u-boot ??= "u-boot-turris"
PREFERRED_PROVIDER_u-boot-fw-utils ??= "u-boot-fw-utils-turris"
PREFERRED_RPROVIDER_u-boot-fw-utils ??= "u-boot-fw-utils-turris"
PREFERRED_PROVIDER_u-boot-script ??= "u-boot-script-turris"
PREFERRED_PROVIDER_virtual/bootloader ??= "u-boot-turris"
PREFERRED_PROVIDER_virtual/kernel = "linux-yocto"

PREFERRED_VERSION_linux-yocto = "5.10.%"
PREFERRED_VERSION_linux-libc-headers = "5.10.%"
PREFERRED_VERSION_xfsprogs = "4.8.0"
PREFERRED_VERSION_php_dunfell = "7.1.%"
PREFERRED_VERSION_php-native_dunfell = "7.1.%"

PREFERRED_PROVIDER_hal-wifi = "hal-wifi-cfg80211"

KERNEL_IMAGETYPE = "zImage"

#for sysupgrade image creation
IMAGE_FSTYPES += " wic"
do_image_wic[depends] += " dosfstools-native:do_populate_sysroot mtools-native:do_populate_sysroot"

#for sdk support
INHERIT_append = " uninative"
BB_SETSCENE_ENFORCE_WHITELIST_append = " %:* *:do_fetch *"
```

## recipes-bsp/u-boot/files/armada_38x_defconfig
```kconfig
CONFIG_SPI_FLASH_WINBOND=y
CONFIG_CMD_FAT=y
CONFIG_MMC_SDMA=y
CONFIG_EEPRO100=y
CONFIG_SYS_USB_XHCI_MAX_ROOT_PORTS=y
CONFIG_BOOTM_NETBSD=y
CONFIG_BOARD_EARLY_INIT_F=y
CONFIG_PCIE_IF_MAPPING=y
CONFIG_SYS_ATA_DATA_OFFSET=0x0000
CONFIG_CMD_ITEST=y
CONFIG_CMD_EDITENV=y
CONFIG_CMD_MTDPARTS=y
CONFIG_SYS_GBL_DATA_SIZE=128
CONFIG_CMD_CRC32=y
CONFIG_SF_DEFAULT_MODE="SPI_MODE_3"
CONFIG_SYS_LONGHELP=y
CONFIG_CMD_SYS_RESTORE=y
CONFIG_SYS_LOAD_ADDR=0x02000000
CONFIG_SYS_SCSI_MAX_SCSI_ID="(4 * CONFIG_SCSI_MAX_CONTROLLERS)"
CONFIG_CMD_XIMG=y
CONFIG_ARMADA_38X=y
CONFIG_STACKSIZE="(1 << 20)"
CONFIG_BOOTDELAY=3
CONFIG_SYS_FLASH_SIZE="_16M"
CONFIG_SYS_NAND_BASE="DEVICE_CS0_BASE"
CONFIG_SPI_FLASH=y
CONFIG_SYS_HELP_CMD_WIDTH=8
CONFIG_SYS_NO_FLASH_NO_HANG=y
CONFIG_NR_DRAM_BANKS=2
CONFIG_EFI_PARTITION=y
CONFIG_FS_FAT=y
CONFIG_BOOTM_RTEMS=y
CONFIG_SYS_CBSIZE=1024
CONFIG_CMD_UBI=y
CONFIG_SYS_MONITOR_LEN=0x80000
CONFIG_SDHCI=y
CONFIG_BOOTM_LINUX=y
CONFIG_BOARD_LATE_INIT=y
CONFIG_CMD_CONSOLE=y
CONFIG_UBOOT_SIZE=0x100000
CONFIG_SYS_CPU="armv7"
CONFIG_BOOTP_MASK="(CONFIG_BOOTP_DEFAULT | CONFIG_BOOTP_BOOTFILESIZE)"
CONFIG_SYS_MALLOC_BASE="(CONFIG_SYS_TEXT_BASE + (3 << 20))"
CONFIG_BOOTP_PXE_CLIENTARCH=0x100
CONFIG_SYS_ATA_IDE0_OFFSET=0x0000
CONFIG_SYS_CACHELINE_SIZE=32
CONFIG_MMC=y
CONFIG_SATA_AHCI_MV=y
CONFIG_ENV_OFFSET_NOR=0x100000
CONFIG_SCSI_MV92XX=y
CONFIG_MTD_PARTITIONS=y
CONFIG_ROOTPATH="/srv/nfs/"
CONFIG_CMD_MISC=y
CONFIG_ZERO_BOOTDELAY_CHECK=y
CONFIG_MISC_INIT_R=y
CONFIG_ENV_OFFSET="CONFIG_ENV_OFFSET_SPI"
CONFIG_USB_MAX_CONTROLLER_COUNT=y
CONFIG_ENV_SPI_CS=0
CONFIG_ENV_OVERWRITE=y
CONFIG_CMD_NET=y
CONFIG_CMD_NFS=y
CONFIG_SCSI_DEV_LIST="{ 0x1B4B, 0x9215 }, { 0x1B4B, 0x9235 }, { 0, 0 }"
CONFIG_ENV_SIZE="CONFIG_ENV_SECT_SIZE"
CONFIG_USB_XHCI=y
CONFIG_CMD_JFFS2=y
CONFIG_CMD_PING=y
CONFIG_SYS_MALLOC_LEN="(10 << 20)"
CONFIG_PCI_HOST="PCI_HOST_FORCE"
CONFIG_ENV_SECT_SIZE_SPI=0x10000
CONFIG_INITRD_TAG=y
CONFIG_SYS_I2C_SPEED=100000
CONFIG_SYS_ATA_BASE_ADDR=0x20000000
CONFIG_MARVELL=y
CONFIG_SYS_TEXT_BASE=0x00000000
CONFIG_SYS_DEF_EEPROM_ADDR=0
CONFIG_SYS_FPGA_DRAM_SIZE="_256M"
CONFIG_CMD_SAVEENV=y
CONFIG_ENV_SECT_SIZE="CONFIG_ENV_SECT_SIZE_SPI"
CONFIG_SYS_RESET_ADDRESS=0xffff0000
CONFIG_SYS_BARGSIZE="CONFIG_SYS_CBSIZE"
CONFIG_I2C_MULTI_BUS=y
CONFIG_SYS_64BIT_LBA=y
CONFIG_SYS_CONSOLE_INFO_QUIET=y
CONFIG_ENV_ADDR="CONFIG_ENV_OFFSET"
CONFIG_CMD_RCVR=y
CONFIG_SCSI_AHCI=y
CONFIG_ENV_SIZE_SPI="CONFIG_ENV_SECT_SIZE_SPI"
CONFIG_SF_DEFAULT_BUS="CONFIG_ENV_SPI_BUS"
CONFIG_CMD_MEMORY=y
CONFIG_SPARE_AREA=0x400000
CONFIG_CMD_RUN=y
CONFIG_IPADDR="10.4.50.170"
CONFIG_SYS_PBSIZE="(CONFIG_SYS_CBSIZE + sizeof(CONFIG_SYS_PROMPT) + 16)"
CONFIG_BOARDDIR="board/mv_ebu/a38x"
CONFIG_ENV_MIN_ENTRIES=128
CONFIG_SYS_IDE_MAXBUS=4
CONFIG_SPI_FLASH_STMICRO=y
CONFIG_OF_LIBFDT=y
CONFIG_SYS_DRAM_BANKS=2
CONFIG_SUPPORT_VFAT=y
CONFIG_SYS_TCLK="mvTclkGet()"
CONFIG_LOADS_ECHO=0
CONFIG_CMDLINE_EDITING=y
CONFIG_CMD_USB=y
CONFIG_SYS_I2C_MULTI_EEPROMS=y
CONFIG_CMD_EXT2=y
CONFIG_CMD_EXT4=y
CONFIG_USB_EHCI=y
CONFIG_SYS_MIN_HDR_DEL_SIZE=0x100
CONFIG_USB_XHCI_HCD=y
CONFIG_ISO_PARTITION=y
CONFIG_CMD_SETGETDCR=y
CONFIG_CMD_EEPROM=y
CONFIG_SYS_NAND_MAX_CHIPS=y
CONFIG_DDR3=y
CONFIG_BOOTP_VCI_STRING="U-boot.armv7.armada_38x"
CONFIG_SYS_MMC_MAX_BLK_COUNT=0x100
CONFIG_ZLIB=y
CONFIG_PIC_GPIO=y
CONFIG_CMD_GO=y
CONFIG_MARVELL_TAG=y
CONFIG_CMD_BOOTD=y
CONFIG_CMD_BOOTM=y
CONFIG_CMD_BOOTZ=y
CONFIG_NET_MULTI=y
CONFIG_AUTO_COMPLETE=y
CONFIG_SYS_SOC="mvca9"
CONFIG_SYS_SCSI_MAX_LUN=y
CONFIG_SYS_HZ=1000
CONFIG_DOS_PARTITION=y
CONFIG_GZIP=y
CONFIG_SYS_VENDOR="mv_ebu"
CONFIG_CMD_SF=y
CONFIG_ENV_OFFSET_SPI=0x100000
CONFIG_SYS_NVRAM_BASE_ADDR="DEVICE_CS1_BASE"
CONFIG_SYS_LOADS_BAUD_CHANGE=y
CONFIG_BZIP2=y
CONFIG_CMD_FPGA=y
CONFIG_CMD_STAGE_BOOT=y
CONFIG_IDENT_STRING=" Marvell version: armada-17.06.2"
CONFIG_USB_MAX_CONTROLLER_HOST_COUNT=2
CONFIG_CMD_SAR=y
CONFIG_SYS_BAUDRATE_TABLE="{ 9600, 19200, 38400, 57600, 115200, 230400, 460800, 921600 }"
CONFIG_SYS_BUS_HZ="mvSysClkGet()"
CONFIG_SYS_DCACHE_OFF=y
CONFIG_SYS_HUSH_PARSER=y
CONFIG_SYS_SDRAM_BASE=0x00000000
CONFIG_SYS_BOOT_RAMDISK_HIGH=y
CONFIG_SYS_MAXARGS=32
CONFIG_CMD_SPI=y
CONFIG_CMD_DHCP=y
CONFIG_SYS_PROMPT_HUSH_PS2="> "
CONFIG_USB_ETHER_ASIX=y
CONFIG_CMD_ECHO=y
CONFIG_GENERIC_MMC=y
CONFIG_SYS_SCSI_MAX_DEVICE="(CONFIG_SYS_SCSI_MAX_SCSI_ID * CONFIG_SYS_SCSI_MAX_LUN)"
CONFIG_SYS_DUART_CHAN=0
CONFIG_SYS_MONITOR_BASE=0
CONFIG_ENV_SPI_MAX_HZ=50000000
CONFIG_CMD_SCSI=y
CONFIG_BOOTP_PXE=y
CONFIG_SYS_INIT_SP_ADDR=0x00FF0000
CONFIG_SYS_ARCH="arm"
CONFIG_MV_SDHCI=y
CONFIG_SYS_MAX_I2C_BUS=2
CONFIG_E1000=y
CONFIG_CMD_BOOT_MENU=y
CONFIG_BAUDRATE=115200
CONFIG_SYS_I2C_EEPROM_ADDR_LEN=y
CONFIG_SYS_BOARD="a38x"
CONFIG_SYS_BOOTMAPSZ="(16 << 20)"
CONFIG_ENV_IS_IN_SPI_FLASH=y
CONFIG_NETMASK="255.255.255.0"
CONFIG_CMDLINE_TAG=y
CONFIG_SYS_MMC_MAX_DEVICE=y
CONFIG_ENV_ADDR_NOR="(NOR_CS_BASE + CONFIG_ENV_OFFSET_NOR)"
CONFIG_SYS_MMC_NUM=y
CONFIG_CMD_IMPORTENV=y
CONFIG_OF_BOARD_SETUP=y
CONFIG_CMD_EXPORTENV=y
CONFIG_CMD_PCI=y
CONFIG_USB_HOST_ETHER=y
CONFIG_PARTITIONS=y
CONFIG_SCSI_AHCI_PLAT=y
CONFIG_SYS_MEMTEST_END=0x007fffff
CONFIG_CMD_I2C=y
CONFIG_CMD_UBIFS=y
CONFIG_CMD_ELF=y
CONFIG_LIBATA=y
CONFIG_CMD_DATE=y
CONFIG_SYS_NO_FLASH=y
CONFIG_FS_EXT4=y
CONFIG_SYS_FLASH_BASE="DEVICE_SPI_BASE"
CONFIG_SWITCHING_SERVICES=y
CONFIG_SYS_MAX_FLASH_BANKS=y
CONFIG_MTD_DEVICE=y
CONFIG_CMD_SOURCE=y
CONFIG_PCI_PNP=y
CONFIG_SYS_PROMPT="Marvell>> "
CONFIG_MMC_SDHCI_IO_ACCESSORS=y
CONFIG_USB_STORAGE=y
CONFIG_CMD_PXE=y
CONFIG_CMD_IDE=y
CONFIG_SPI_FLASH_MACRONIX=y
CONFIG_SYS_ATA_REG_OFFSET=0x0000
CONFIG_DISPLAY_CPUINFO=y
CONFIG_SETUP_MEMORY_TAGS=y
CONFIG_SCSI_MAX_CONTROLLERS=6
CONFIG_EXT4_WRITE=y
CONFIG_SYS_MEMTEST_START=0x00400000
CONFIG_CMD_LOADB=y
CONFIG_MV_ETH_NETA=y
CONFIG_CMD_LOADS=y
CONFIG_CMD_IMI=y
CONFIG_SYS_MMC_BASE="(INTER_REGS_BASE + MV_SDMMC_REGS_OFFSET)"
CONFIG_CMD_EXT4_WRITE=y
CONFIG_SF_DEFAULT_SPEED="CONFIG_ENV_SPI_MAX_HZ"
CONFIG_ENV_SECT_SIZE_NOR=0x20000
CONFIG_API=y
CONFIG_LMB=y
CONFIG_ARM=y
CONFIG_RBTREE=y
CONFIG_SYS_IDE_MAXDEVICE="CONFIG_SYS_IDE_MAXBUS * 8"
CONFIG_ENV_SPI_BUS="mvBoardSpiBusGet()"
CONFIG_SYS_BUS_CLK="CONFIG_SYS_BUS_HZ"
CONFIG_CMD_BDI=y
CONFIG_SERVERIP="10.4.50.38"
CONFIG_SYS_USE_UBI=y
CONFIG_ENV_RANGE_NOR="CONFIG_ENV_SIZE_NOR * 8"
CONFIG_LBA48=y
CONFIG_LZO=y
CONFIG_PCI=y
CONFIG_EHCI_IS_TDI=y
CONFIG_BOOTSTAGE_USER_COUNT=20
CONFIG_MENU=y
CONFIG_SCSI_6820=y
CONFIG_CMD_MMC=y
CONFIG_ENV_SIZE_NOR=0x20000
CONFIG_SF_DEFAULT_CS="CONFIG_ENV_SPI_CS"
CONFIG_CMD_BSP=y
CONFIG_SYS_NVRAM_SIZE=0x00
```
